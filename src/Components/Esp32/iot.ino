#include <Adafruit_Fingerprint.h>  //https://github.com/adafruit/Adafruit-Fingerprint-Sensor-Library
#include <HardwareSerial.h>
#include <Adafruit_GFX.h>      //https://github.com/adafruit/Adafruit-GFX-Library
#include <Adafruit_SSD1306.h>  //https://github.com/adafruit/Adafruit_SSD1306
#include <SPI.h>
#include "time.h"
#include "sntp.h"

#include <WiFi.h>
#include <WiFiClient.h>

#define SCREEN_WIDTH 128  // OLED display width, in pixels
#define SCREEN_HEIGHT 64  // OLED display height, in pixels

#include <ArduinoJson.h>
#include <FirebaseESP32.h>


#define WIFI_SSID "iot"
#define WIFI_PASSWORD "88888888"
// Declaration for an SSD1306 display connected to I2C (SDA, SCL pins)
#define OLED_RESET -1  // Reset pin # (or -1 if sharing Arduino reset pin)
Adafruit_SSD1306 display(SCREEN_WIDTH, SCREEN_HEIGHT, &Wire, OLED_RESET);

int id;
uint8_t getFingerprintEnroll();

FirebaseData firebaseData;
String data = "{\"state\": false }";
String path = "/";
bool out = true;
const char* ntpServer1 = "pool.ntp.org";
const char* ntpServer2 = "time.nist.gov";
const long gmtOffset_sec = (3600 * 7) + (30 * 0);
const int daylightOffset_sec = 3600;

const char* time_zone = "CET-1CEST,M3.5.0,M10.5.0/3";
void printLocalTime() {
  struct tm timeinfo;
  if (!getLocalTime(&timeinfo)) {
    Serial.println("No time available (yet)");
    return;
  }
}

void timeavailable(struct timeval* t) {
  printLocalTime();
}
// Icon of Fingerprint
#define LOGO_HEIGHT 64
#define LOGO_WIDTH 128
static const unsigned char PROGMEM logo_bmp[] = {
  0x00, 0x00, 0x00, 0x00, 0x00, 0x00, 0x00, 0x00, 0x00, 0x00, 0x00, 0x00, 0x00, 0x00, 0x00, 0x00,
  0x00, 0x00, 0x00, 0x00, 0x00, 0x00, 0x00, 0x00, 0x00, 0x00, 0x00, 0x00, 0x00, 0x00, 0x00, 0x00,
  0x00, 0x00, 0x00, 0x00, 0x00, 0x00, 0x03, 0xff, 0xc0, 0x00, 0x00, 0x00, 0x00, 0x00, 0x00, 0x00,
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  0x00, 0x00, 0x00, 0x00, 0x00, 0x00, 0x00, 0x00, 0x00, 0x00, 0x00, 0x00, 0x00, 0x00, 0x00, 0x00
};

//---------------------------------------------------------------
#define Fingerprint_valid_width 64
#define Fingerprint_valid_height 64
static const unsigned char PROGMEM Fingerprint_valid_bts[] = {
  0x00, 0x00, 0x03, 0xfe, 0x00, 0x00, 0x00, 0x00, 0x00, 0x00, 0x1f, 0xff,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 0x00
};
//---------------------------------------------------------------
#define Fingerprint_invalid_width 64
#define Fingerprint_invalid_height 64
static const unsigned char PROGMEM Fingerprint_invalid_bts[] = {
  0x00, 0x00, 0x03, 0xfe, 0x00, 0x00, 0x00, 0x00, 0x00, 0x00, 0x1f, 0xff,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 0x00
};
//---------------------------------------------------------------

bool state_face;

Adafruit_Fingerprint finger = Adafruit_Fingerprint(&Serial2);

//đăng ký vân tay

uint8_t getFingerprintEnroll() {
  String mess = "";
  mess = "Ready to enroll a fingerprint!";
  Firebase.setString(firebaseData, "/mess", mess);
  delay(1000);
  Serial.println(mess);
  mess = "Please type in the ID # (from 1 to 127) you want to save this finger as...";
  Firebase.setString(firebaseData, "/mess", mess);
  delay(1000);
  Serial.println(mess);
  delay(10000);
  if (Firebase.getString(firebaseData, "/dangKy/id")) {
    String idStr = firebaseData.stringData();
    id = idStr.toInt();
    Serial.println(id);
    int p = -1;
    mess = "Waiting for valid finger to enroll as #" + idStr;
    Firebase.setString(firebaseData, "/mess", mess);
    Serial.print(mess);
    while (p != FINGERPRINT_OK) {
      p = finger.getImage();
      switch (p) {
        case FINGERPRINT_OK:
          mess = "Image taken";
          Firebase.setString(firebaseData, "/mess", mess);
          Serial.println(mess);
          break;
        case FINGERPRINT_NOFINGER:
          mess += ".";
          Firebase.setString(firebaseData, "/mess", mess);
          Serial.print(".");
          break;
        case FINGERPRINT_PACKETRECIEVEERR:
          mess = "Communication error";
          Firebase.setString(firebaseData, "/mess", mess);
          Serial.println(mess);
          break;
        case FINGERPRINT_IMAGEFAIL:
          mess = "Imaging error";
          Firebase.setString(firebaseData, "/mess", mess);
          Serial.println(mess);
          break;
        default:
          mess = "Unknown error";
          Firebase.setString(firebaseData, "/mess", mess);
          Serial.println(mess);
          break;
      }
    }

    // OK success!
    delay(1000);

    p = finger.image2Tz(1);
    switch (p) {
      case FINGERPRINT_OK:
        mess = "Image converted";
        Firebase.setString(firebaseData, "/mess", mess);
        Serial.println(mess);
        break;
      case FINGERPRINT_IMAGEMESS:
        mess = "Image too messy";
        Firebase.setString(firebaseData, "/mess", mess);
        Serial.println(mess);
        return p;
      case FINGERPRINT_PACKETRECIEVEERR:
        mess = "Communication error";
        Firebase.setString(firebaseData, "/mess", mess);
        Serial.println(mess);
        return p;
      case FINGERPRINT_FEATUREFAIL:
        mess = "Could not find fingerprint features";
        Firebase.setString(firebaseData, "/mess", mess);
        Serial.println(mess);
        return p;
      case FINGERPRINT_INVALIDIMAGE:
        mess = "Could not find fingerprint features";
        Firebase.setString(firebaseData, "/mess", mess);
        Serial.println(mess);
        return p;
      default:
        mess = "Unknown error";
        Firebase.setString(firebaseData, "/mess", mess);
        Serial.println(mess);
        return p;
    }
    delay(1000);

    mess = "Remove finger";
    Firebase.setString(firebaseData, "/mess", mess);
    Serial.println(mess);
    delay(2000);
    p = 0;
    while (p != FINGERPRINT_NOFINGER) {
      p = finger.getImage();
    }

    Serial.print("ID ");
    Serial.println(id);
    delay(1000);

    p = -1;
    mess = "Place same finger again";
    Firebase.setString(firebaseData, "/mess", mess);
    Serial.println(mess);
    while (p != FINGERPRINT_OK) {
      p = finger.getImage();
      switch (p) {
        case FINGERPRINT_OK:
          mess = "Image taken";
          Firebase.setString(firebaseData, "/mess", mess);
          Serial.println(mess);
          break;
        case FINGERPRINT_NOFINGER:
          mess += ".";
          Firebase.setString(firebaseData, "/mess", mess);
          Serial.print(".");
          break;
        case FINGERPRINT_PACKETRECIEVEERR:
          mess = "Communication error";
          Firebase.setString(firebaseData, "/mess", mess);
          Serial.println(mess);
          break;
        case FINGERPRINT_IMAGEFAIL:
          mess = "Imaging error";
          Firebase.setString(firebaseData, "/mess", mess);
          Serial.println(mess);
          break;
        default:
          mess = "Unknown error";
          Firebase.setString(firebaseData, "/mess", mess);
          Serial.println(mess);
          break;
      }
    }

    // OK success!
    delay(1000);

    p = finger.image2Tz(2);
    switch (p) {
      case FINGERPRINT_OK:
        mess = "Image converted";
        Firebase.setString(firebaseData, "/mess", mess);
        Serial.println(mess);
        break;
      case FINGERPRINT_IMAGEMESS:
        mess = "Image too messy";
        Firebase.setString(firebaseData, "/mess", mess);
        Serial.println(mess);
        return p;
      case FINGERPRINT_PACKETRECIEVEERR:
        mess = "Communication error";
        Firebase.setString(firebaseData, "/mess", mess);
        Serial.println(mess);
        return p;
      case FINGERPRINT_FEATUREFAIL:
        mess = "Could not find fingerprint features";
        Firebase.setString(firebaseData, "/mess", mess);
        Serial.println(mess);
        return p;
      case FINGERPRINT_INVALIDIMAGE:
        mess = "Could not find fingerprint features";
        Firebase.setString(firebaseData, "/mess", mess);
        Serial.println(mess);
        return p;
      default:
        mess = "Unknown error";
        Firebase.setString(firebaseData, "/mess", mess);
        Serial.println(mess);
        return p;
    }
    delay(1000);

    // OK converted!
    mess = "Creating model for #" + idStr;
    Firebase.setString(firebaseData, "/mess", mess);
    Serial.println(mess);

    p = finger.createModel();
    if (p == FINGERPRINT_OK) {
      mess = "Prints matched!";
      Firebase.setString(firebaseData, "/mess", mess);
      Serial.println(mess);
    } else if (p == FINGERPRINT_PACKETRECIEVEERR) {
      mess = "Communication error";
      Firebase.setString(firebaseData, "/mess", mess);
      Serial.println(mess);
      return p;
    } else if (p == FINGERPRINT_ENROLLMISMATCH) {
      mess = "Fingerprints did not match";
      Firebase.setString(firebaseData, "/mess", mess);
      Serial.println(mess);
      return p;
    } else {
      mess = "Unknown error";
      Firebase.setString(firebaseData, "/mess", mess);
      Serial.println(mess);
      return p;
    }
    delay(1000);

    Serial.print("ID ");
    Serial.println(id);
    p = finger.storeModel(id);
    if (p == FINGERPRINT_OK) {
      Firebase.setString(firebaseData, "/mess", "Stored!");
      Serial.println("Stored!");
    } else if (p == FINGERPRINT_PACKETRECIEVEERR) {
      mess = "Communication error";
      Firebase.setString(firebaseData, "/mess", mess);
      Serial.println(mess);
      return p;
    } else if (p == FINGERPRINT_BADLOCATION) {
      mess = "Could not store in that location";
      Firebase.setString(firebaseData, "/mess", mess);
      Serial.println(mess);
      return p;
    } else if (p == FINGERPRINT_FLASHERR) {
      mess = "Error writing to flash";
      Firebase.setString(firebaseData, "/mess", mess);
      Serial.println(mess);
      Serial.println("Error writing to flash");
      return p;
    } else {
      mess = "Unknown error";
      Firebase.setString(firebaseData, "/mess", mess);
      Serial.println(mess);
      return p;
    }
  }

  return true;
}

int relayPin = 23;
int buzzerPin = 15;
void setup_wifi() {
  Serial.println();
  Serial.print("Connecting to ");
  Serial.println(WIFI_SSID);
  WiFi.begin(WIFI_SSID, WIFI_PASSWORD);

  while (WiFi.status() != WL_CONNECTED) {

    Serial.print(".");
  }
  Serial.println();
  Serial.println("WiFi connected");

  Firebase.begin("iot-project-74c0f-default-rtdb.firebaseio.com/", "ICTKopkjrxq0ZcuvwVITayqFTTZ2eHiVv3HPbfqa");
  Firebase.reconnectWiFi(true);
  Serial.println("");
  Serial.println("FireBase connected");
}

void setup() {
  pinMode(relayPin, OUTPUT);
  pinMode(buzzerPin, OUTPUT);

  digitalWrite(relayPin, HIGH);
  digitalWrite(buzzerPin, LOW);

  Serial.begin(57600);
  Serial2.begin(115200);
  sntp_set_time_sync_notification_cb(timeavailable);


  sntp_servermode_dhcp(1);  // (optional)

  configTime(gmtOffset_sec, daylightOffset_sec, ntpServer1, ntpServer2);
  setup_wifi();
  if (!display.begin(SSD1306_SWITCHCAPVCC, 0x3C)) {
    Serial.println(F("SSD1306 allocation failed"));
    for (;;)
      ;  // Don't proceed, loop forever
  }

  while (!Serial)
    ;
  delay(100);

  display.clearDisplay();
  display.drawBitmap(0, 0, logo_bmp, LOGO_WIDTH, LOGO_HEIGHT, 1);
  display.display();

  Serial.println("Fingerprint Door Lock");
  delay(3000);
  display.clearDisplay();

  // set the data rate for the sensor serial port
  finger.begin(57600);

  if (finger.verifyPassword()) {
    Serial.println("Fingerprint Sensor Connected");
    display.clearDisplay();
    display.setTextSize(2);               // Normal 1:1 pixel scale
    display.setTextColor(SSD1306_WHITE);  // Draw white text
    display.setCursor(25, 0);             // Start at top-left corner
    display.println(("Sensor"));
    display.setCursor(5, 35);
    display.println("Connected");
    display.display();
    delay(3000);
    display.clearDisplay();
  }

  else {
    display.clearDisplay();
    display.setTextSize(2);               // Normal 1:1 pixel scale
    display.setTextColor(SSD1306_WHITE);  // Draw white text
    display.setCursor(25, 0);             // Start at top-left corner
    display.println(("Sensor"));
    display.setCursor(5, 35);
    display.println("Not Found");
    display.display();

    Serial.println("Unable to find Sensor");
    delay(3000);
    Serial.println("Check Connections");

    while (1) {
      delay(1);
    }
  }
  display.clearDisplay();
}

void loop()  // run over and over again
{ 
  if(Firebase.getBool(firebaseData, "/state")){
    state_face=firebaseData.boolData();
    if(state_face){
      digitalWrite(relayPin,LOW);
      delay(6000);
      digitalWrite(relayPin,HIGH);
      Firebase.setBool(firebaseData, "/state", false);
    }
    else if (Firebase.getBool(firebaseData, "/dangKy/state")) {
    bool state = firebaseData.boolData();
    if (state) {
      bool kq = getFingerprintEnroll();
      Firebase.setBool(firebaseData, "/dangKy/state", false);
    } else {
      getFingerprintIDez();
    }
  } else {
    getFingerprintIDez();
  }
  } else if (Firebase.getBool(firebaseData, "/dangKy/state")) {
    bool state = firebaseData.boolData();
    if (state) {
      bool kq = getFingerprintEnroll();
      Firebase.setBool(firebaseData, "/dangKy/state", false);
    } else {
      getFingerprintIDez();
    }
  } else {
    getFingerprintIDez();
  }
  
}

// returns -1 if failed, otherwise returns ID #
int getFingerprintIDez() {
  uint8_t p = finger.getImage();
  if (p != FINGERPRINT_OK) {

    display.clearDisplay();
    display.drawBitmap(0, 0, logo_bmp, LOGO_WIDTH, LOGO_HEIGHT, 1);
    display.display();
    return -1;
  }

  p = finger.image2Tz();
  if (p != FINGERPRINT_OK) {
    display.clearDisplay();
    display.setTextSize(2);               // Normal 1:1 pixel scale
    display.setTextColor(SSD1306_WHITE);  // Draw white text
    display.setCursor(0, 0);              // Start at top-left corner
    display.println(("Messy  Image"));
    display.setCursor(0, 35);
    display.println("Try Again");
    display.display();

    Serial.println("Messy Image Try Again");
    delay(3000);
    display.clearDisplay();
    return -1;
  }

  p = finger.fingerFastSearch();
  if (p != FINGERPRINT_OK) {

    display.clearDisplay();
    display.setTextSize(2);               // Normal 1:1 pixel scale
    display.setTextColor(SSD1306_WHITE);  // Draw white text
    display.drawBitmap(34, 0, Fingerprint_invalid_bts, Fingerprint_invalid_width, Fingerprint_invalid_height, 1);
    display.display();
    Serial.println("Not Valid Finger");
    digitalWrite(buzzerPin, HIGH);
    delay(3000);
    display.clearDisplay();

    digitalWrite(buzzerPin, LOW);
    struct tm timeinfo;
    if (!getLocalTime(&timeinfo)) {
      Serial.println("No time available (yet)");
    }
    char buffer[80];  // Để lưu chuỗi định dạng
    strftime(buffer, sizeof(buffer), "%A, %B %d %Y %H:%M:%S", &timeinfo);

    String formattedTime = String(buffer);
    Serial.println("Formatted Time: " + formattedTime);
    if (Firebase.getString(firebaseData, "/count")) {
      String s = firebaseData.stringData();
      String path = "/history/" + s;
      Firebase.setBool(firebaseData, path + "/state", false);
      Firebase.setString(firebaseData, path + "/time", formattedTime);
      int dem = s.toInt() + 1;
      Firebase.setString(firebaseData, "/count", String(dem));
    }
    return -1;
  }

  // found a match!
  display.clearDisplay();
  display.setTextColor(SSD1306_WHITE);  // Draw white text
  display.setTextSize(2);
  display.drawBitmap(34, 0, Fingerprint_valid_bts, Fingerprint_valid_width, Fingerprint_valid_height, 1);
  display.display();
  digitalWrite(relayPin, LOW);
  delay(1000);
  display.clearDisplay();
  display.setCursor(40, 0);  // Start at top-left corner
  display.println(("Door"));
  display.setCursor(15, 20);  // Start at top-left corner
  display.println(("Unlocked"));
  display.setCursor(20, 40);
  display.println("Welcome");
  display.display();
  Firebase.setBool(firebaseData,"/state", true);
  delay(6000);

  display.clearDisplay();
  display.setTextSize(2);               // Normal 1:1 pixel scale
  display.setTextColor(SSD1306_WHITE);  // Draw white text
  display.setCursor(20, 20);            // Start at top-left corner
  display.println(("Closing"));
  display.setCursor(20, 40);  // Start at top-left corner
  display.println(("the Door"));
  display.display();
  digitalWrite(relayPin, HIGH);
  Firebase.setBool(firebaseData, "/state", false);
  delay(3000);

  display.clearDisplay();

  Serial.println("Door Unlocked Welcome");
  struct tm timeinfo;
  if (!getLocalTime(&timeinfo)) {
    Serial.println("No time available (yet)");
  }
  char buffer[80];  // Để lưu chuỗi định dạng
  strftime(buffer, sizeof(buffer), "%A, %B %d %Y %H:%M:%S", &timeinfo);

  String formattedTime = String(buffer);
  Serial.println("Formatted Time: " + formattedTime);
  if (Firebase.getString(firebaseData, "/count")) {
    String s = firebaseData.stringData();
    String path = "/history/" + s;
    Firebase.setBool(firebaseData, path + "/state", true);
    Firebase.setString(firebaseData, path + "/time", formattedTime);
    int dem = s.toInt() + 1;
    Firebase.setString(firebaseData, "/count", String(dem));
  }
  
  return finger.fingerID;
}